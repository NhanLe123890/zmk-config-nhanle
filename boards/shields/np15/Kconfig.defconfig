## boards/shields/np15/Kconfig.defconfig
```kconfig
if SHIELD_NP15

# Name must be less than 16 characters long!
config ZMK_KEYBOARD_NAME
    default "Numpad"

endif
```

## boards/shields/quefrency_nhanle/Kconfig.defconfig
```kconfig
if SHIELD_QUEFRENCY_NHANLE_LEFT

config ZMK_KEYBOARD_NAME
    default "Quefrency_NL"

config ZMK_SPLIT_ROLE_CENTRAL
    default y

endif

if SHIELD_QUEFRENCY_NHANLE_LEFT || SHIELD_QUEFRENCY_NHANLE_RIGHT

config ZMK_SPLIT
    default y

endif
```

## boards/shields/quefrency_nhanle/Kconfig.shield
```kconfig
config SHIELD_QUEFRENCY_NHANLE_LEFT
    def_bool $(shields_list_contains,quefrency_nhanle_left)

config SHIELD_QUEFRENCY_NHANLE_RIGHT
    def_bool $(shields_list_contains,quefrency_nhanle_right)
```
